## config/boards/shields/totem_left/Kconfig.defconfig
```kconfig
# Copyright (c) 2022 The ZMK Contributors
# SPDX-License-Identifier: MIT

if SHIELD_TOTEM_LEFT

config ZMK_KEYBOARD_NAME
    default "TOTEM L"

endif
```

## config/boards/shields/totem_right/Kconfig.defconfig
```kconfig
# Copyright (c) 2022 The ZMK Contributors
# SPDX-License-Identifier: MIT

if SHIELD_TOTEM_RIGHT

config ZMK_KEYBOARD_NAME
    default "TOTEM R"

endif
```
